## main/Kconfig.projbuild
```kconfig
menu "KinCal Integration"
    config KINCAL_HOST
        string "KinCal server host"
        default "kincal.cn"
        help
            Hostname the firmware contacts to fetch device display data.
            Override for local dev (e.g. 192.168.1.42).

    config KINCAL_USE_HTTPS
        bool "Use HTTPS"
        default y
        help
            Toggle HTTPS (port 443) vs HTTP (port 80).

    config KINCAL_SKIP_CERT_VERIFY
        bool "Skip TLS certificate verification (dev only)"
        default n
        help
            DANGER: skips server certificate validation. Use only against
            a local dev server with a self-signed cert. Must never be y
            in production firmware.

    config KINCAL_DEFAULT_SHORT_CODE
        string "Default KinCal short code (factory provisioning)"
        default ""
        help
            Pre-provisioned 6-char short code baked into the factory firmware.
            Empty means the user must configure via the AP captive portal.
            NVS value (if set at runtime) takes precedence over this default.

    config KINCAL_DEFAULT_HAS_BACK_KEY
        bool "Default 4-key hardware (BACK button on GPIO43 present)"
        default n
        help
            Factory default for whether the device has the 4th physical key.
            Original Waveshare RLCD has only 3 keys (PREV/NEXT/ENTER) — leave n.
            NVS value (set via captive portal) takes precedence over this default.

    config KINCAL_LEGACY_DIRECT_APIS
        bool "Compile legacy direct CalDAV/Open-Meteo clients"
        default n
        help
            Escape hatch: keeps caldav.c / weather.c / their fetch calls
            compilable so the firmware can run without KinCal. Default off
            — once KinCal integration is stable, leave this off and the
            legacy sources are excluded from the build.
endmenu

menu "Enabled Apps"
    config KINCAL_APP_XIAOZHI
        bool "Enable XiaoZhi voice assistant app"
        default n
        help
            Phase B app. Off by default for KinCal-only firmware;
            toggle on for the multi-app firmware variant.

    config KINCAL_APP_CODEPILOT
        bool "Enable CodePilot agent dashboard app"
        default n
        help
            Phase B app. Off by default for KinCal-only firmware.

    config KINCAL_APP_SNAKE
        bool "Enable Snake game"
        default n
        help
            Phase C game. Off by default for KinCal-only firmware.

    config KINCAL_APP_TETRIS
        bool "Enable Tetris game"
        default n
        help
            Phase D game. Off by default for KinCal-only firmware.

    config KINCAL_APP_TOWER
        bool "Enable Tower Defense game"
        default n
        help
            Turret defense game. PREV/NEXT rotate the central turret,
            ENTER fires. Designed for 4-key hardware; on single-key
            firmware entering the app exits immediately (same as
            Snake/Tetris).
endmenu
```

## sdkconfig.defaults
```kconfig
# Board
CONFIG_IDF_TARGET="esp32s3"

# Flash
CONFIG_ESPTOOLPY_FLASHMODE_DIO=y
CONFIG_ESPTOOLPY_FLASHFREQ_80M=y
CONFIG_ESPTOOLPY_FLASHSIZE_16MB=y

# Partition table
CONFIG_PARTITION_TABLE_CUSTOM=y
CONFIG_PARTITION_TABLE_CUSTOM_FILENAME="partitions.csv"

# PSRAM (8MB octal on ESP32-S3-WROOM-1-N16R8)
CONFIG_SPIRAM=y
CONFIG_SPIRAM_MODE_OCT=y
CONFIG_SPIRAM_SPEED_80M=y
CONFIG_SPIRAM_MALLOC_ALWAYSINTERNAL=512
CONFIG_SPIRAM_MALLOC_RESERVE_INTERNAL=65536

# C++ support (required for XiaoZhi component)
CONFIG_COMPILER_CXX_EXCEPTIONS=y
CONFIG_COMPILER_CXX_EXCEPTIONS_EMG_POOL_SIZE=1024

# Code size optimization
CONFIG_COMPILER_OPTIMIZATION_SIZE=y
CONFIG_NEWLIB_NANO_FORMAT=y

# Main task stack (XiaoZhi event loop + calendar tasks)
CONFIG_ESP_MAIN_TASK_STACK_SIZE=8192

# Memory optimization
CONFIG_ESP_WIFI_STATIC_RX_BUFFER_NUM=3
CONFIG_ESP_WIFI_DYNAMIC_RX_BUFFER_NUM=6
CONFIG_MBEDTLS_EXTERNAL_MEM_ALLOC=y
CONFIG_MBEDTLS_DYNAMIC_BUFFER=y
CONFIG_MBEDTLS_DYNAMIC_FREE_CONFIG_DATA=y
CONFIG_MBEDTLS_SSL_KEEP_PEER_CERTIFICATE=n

# Enabled apps (factory default = Calendar only). Toggle per deployment.
# MENU + Calendar are always on; the rest are gated here.
CONFIG_KINCAL_APP_XIAOZHI=y
CONFIG_KINCAL_APP_CODEPILOT=y
CONFIG_KINCAL_APP_SNAKE=y
CONFIG_KINCAL_APP_TETRIS=y

# Cache tuning for ESP32-S3
CONFIG_ESP32S3_INSTRUCTION_CACHE_32KB=y

# Watchdog
CONFIG_ESP_TASK_WDT_TIMEOUT_S=10
# XiaoZhi audio pipeline + KinCal TLS handshake + ST7306 SPI redraw are
# CPU-heavy and share CPU 1. Don't subscribe IDLE tasks to the WDT —
# individual worker tasks manage their own yields via vTaskDelay and
# are unsubscribed from the WDT themselves where appropriate.
CONFIG_ESP_TASK_WDT_CHECK_IDLE_TASK_CPU0=n
CONFIG_ESP_TASK_WDT_CHECK_IDLE_TASK_CPU1=n

# Console output via USB Serial/JTAG (frees GPIO43/44 from UART0)
CONFIG_ESP_CONSOLE_USB_SERIAL_JTAG=y
CONFIG_ESP_CONSOLE_SECONDARY_NONE=y

# HTTP Server (CodePilot WebSocket on port 7897)
CONFIG_HTTPD_WS_SUPPORT=y
```
