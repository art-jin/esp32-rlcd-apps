/*
 * ST7306 monochrome reflective LCD driver for Waveshare ESP32-S3-RLCD-4.2
 * Landscape mode: 400 x 300 pixels, 1-bit monochrome
 */

#include "st7306.h"
#include <string.h>
#include "esp_lcd_panel_io.h"
#include "driver/spi_master.h"
#include "freertos/FreeRTOS.h"
#include "freertos/task.h"
#include "freertos/semphr.h"

// ── 8×16 ASCII font (256 chars × 16 bytes = 4096 bytes) ──────────────────────
static const uint8_t font8x16[] = {
    0x00,0x00,0x00,0x00,0x00,0x00,0x00,0x00,0x00,0x00,0x00,0x00,0x00,0x00,0x00,0x00,
    0x00,0x00,0x7e,0x81,0xa5,0x81,0x81,0xbd,0x99,0x81,0x81,0x7e,0x00,0x00,0x00,0x00,
    0x00,0x00,0x7e,0xff,0xdb,0xff,0xff,0xc3,0xe7,0xff,0xff,0x7e,0x00,0x00,0x00,0x00,
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    0x00,0x00,0x00,0x00,0xfe,0xfe,0x7c,0x7c,0x38,0x38,0x10,0x00,0x00,0x00,0x00,0x00,
    /* 0x20: space */
    0x00,0x00,0x00,0x00,0x00,0x00,0x00,0x00,0x00,0x00,0x00,0x00,0x00,0x00,0x00,0x00,
    0x00,0x00,0x18,0x3c,0x3c,0x3c,0x18,0x18,0x18,0x00,0x18,0x18,0x00,0x00,0x00,0x00,
    0x00,0x66,0x66,0x66,0x24,0x00,0x00,0x00,0x00,0x00,0x00,0x00,0x00,0x00,0x00,0x00,
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    0x00,0x00,0x00,0x00,0x02,0x06,0x0c,0x18,0x30,0x60,0xc0,0x80,0x00,0x00,0x00,0x00,
    /* 0x30: digits */
    0x00,0x00,0x38,0x6c,0xc6,0xc6,0xd6,0xd6,0xc6,0xc6,0x6c,0x38,0x00,0x00,0x00,0x00,
    0x00,0x00,0x18,0x38,0x78,0x18,0x18,0x18,0x18,0x18,0x18,0x7e,0x00,0x00,0x00,0x00,
    0x00,0x00,0x7c,0xc6,0x06,0x0c,0x18,0x30,0x60,0xc0,0xc6,0xfe,0x00,0x00,0x00,0x00,
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    0x00,0x00,0x7c,0xc6,0xc6,0x0c,0x18,0x18,0x18,0x00,0x18,0x18,0x00,0x00,0x00,0x00,
    /* 0x40: @ and uppercase letters */
    0x00,0x00,0x00,0x7c,0xc6,0xc6,0xde,0xde,0xde,0xdc,0xc0,0x7c,0x00,0x00,0x00,0x00,
    0x00,0x00,0x10,0x38,0x6c,0xc6,0xc6,0xfe,0xc6,0xc6,0xc6,0xc6,0x00,0x00,0x00,0x00, /* A */
    0x00,0x00,0xfc,0x66,0x66,0x66,0x7c,0x66,0x66,0x66,0x66,0xfc,0x00,0x00,0x00,0x00, /* B */
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    0x30,0x30,0x18,0x00,0x00,0x00,0x00,0x00,0x00,0x00,0x00,0x00,0x00,0x00,0x00,0x00,
    /* 0x60: lowercase letters */
    0x00,0x00,0x00,0x00,0x00,0x78,0x0c,0x7c,0xcc,0xcc,0xcc,0x76,0x00,0x00,0x00,0x00, /* a */
    0x00,0x00,0xe0,0x60,0x60,0x78,0x6c,0x66,0x66,0x66,0x66,0x7c,0x00,0x00,0x00,0x00, /* b */
    0x00,0x00,0x00,0x00,0x00,0x7c,0xc6,0xc0,0xc0,0xc0,0xc6,0x7c,0x00,0x00,0x00,0x00, /* c */
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    0x00,0x00,0x00,0x00,0x10,0x38,0x6c,0xc6,0xc6,0xc6,0xfe,0x00,0x00,0x00,0x00,0x00,
    /* 0x80-0xFF: extended (mostly blank, not needed for our text) */
    /* We skip the extended chars to save space - they're not needed */
};

// ── 16×16 bitmap for Chinese character "的" (UTF-8: E7 9A 84) ────────────────
static const uint8_t font_de_16x16[] = {
    0x00, 0x00,
    0x00, 0x80,
    0x08, 0x40,
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    0x00, 0x00,
};

// ── Private state ─────────────────────────────────────────────────────────────
static esp_lcd_panel_io_handle_t s_io_handle = NULL;
static uint8_t s_framebuf[ST7306_BUF_SIZE]; // zero-initialized = all white

// ── Helper: send command with parameters ──────────────────────────────────────
static inline void send_cmd(uint8_t cmd, const uint8_t *params, int len)
{
    esp_lcd_panel_io_tx_param(s_io_handle, cmd, params, len);
}

static inline void send_cmd_no_params(uint8_t cmd)
{
    esp_lcd_panel_io_tx_param(s_io_handle, cmd, NULL, 0);
}

// ── Pixel set (landscape 2×4 block packing) ──────────────────────────────────
void st7306_set_pixel(int x, int y, int color)
{
    if (x < 0 || x >= ST7306_WIDTH || y < 0 || y >= ST7306_HEIGHT) return;

    int inv_y   = ST7306_HEIGHT - 1 - y;
    int byte_x  = x / 2;
    int block_y = inv_y / 4;
    int index   = byte_x * (ST7306_HEIGHT / 4) + block_y;  // = byte_x * 75 + block_y
    int local_x = x % 2;
    int local_y = inv_y % 4;
    int bit     = 7 - (local_y * 2 + local_x);

    if (color) {
        s_framebuf[index] |= (1 << bit);
    } else {
        s_framebuf[index] &= ~(1 << bit);
    }
}

// ── Clear frame buffer ────────────────────────────────────────────────────────
void st7306_clear(void)
{
    memset(s_framebuf, 0, ST7306_BUF_SIZE);
}

// ── Push frame buffer to display ─────────────────────────────────────────────
// ── Frame buffer mutex (shared between calendar task and XiaoZhi display) ─────
static SemaphoreHandle_t s_fb_mutex = NULL;

SemaphoreHandle_t st7306_get_mutex(void)
{
    return s_fb_mutex;
}

// ── Push frame buffer to display ─────────────────────────────────────────────
void st7306_update_display(void)
{
    if (s_fb_mutex) xSemaphoreTake(s_fb_mutex, portMAX_DELAY);
    uint8_t col_addr[] = { 0x12, 0x2A };
    uint8_t row_addr[] = { 0x00, 0xC7 };
    send_cmd(0x2A, col_addr, sizeof(col_addr));
    send_cmd(0x2B, row_addr, sizeof(row_addr));
    esp_lcd_panel_io_tx_color(s_io_handle, 0x2C, s_framebuf, ST7306_BUF_SIZE);
    if (s_fb_mutex) xSemaphoreGive(s_fb_mutex);
}

// ── Draw a single 8×16 ASCII character ───────────────────────────────────────
static void draw_char_8x16(int x, int y, unsigned char c, int color)
{
    if (c > 0x7F) return;
    // Font table covers 0x00-0x7F (first 128 chars × 16 bytes)
    const uint8_t *glyph = &font8x16[(int)c * 16];
    for (int dy = 0; dy < 16; dy++) {
        uint8_t line = glyph[dy];
        for (int dx = 0; dx < 8; dx++) {
            if (line & (0x80 >> dx)) {
                st7306_set_pixel(x + dx, y + dy, color);
            }
        }
    }
}

// ── Custom 10×20 digit bitmaps (0-9), generated from Helvetica 20pt ──────────
static const uint8_t font_digits_10x20[10][40] = {
    { /* 0 */
      0x00,0x00, 0x00,0x00, 0x1E,0x00, 0x3F,0x00, 0x61,0x80,
      0x61,0xC0, 0xC0,0xC0, 0xC0,0xC0, 0xC0,0xC0, 0xC0,0xC0,
      0xC0,0xC0, 0xC0,0xC0, 0xC0,0xC0, 0x61,0x80, 0x61,0x80,
      0x3F,0x00, 0x1E,0x00, 0x00,0x00, 0x00,0x00, 0x00,0x00
    },
    { /* 1 */
      0x00,0x00, 0x00,0x00, 0x0C,0x00, 0x0C,0x00, 0x1C,0x00,
      0x7C,0x00, 0x0C,0x00, 0x0C,0x00, 0x0C,0x00, 0x0C,0x00,
      0x0C,0x00, 0x0C,0x00, 0x0C,0x00, 0x0C,0x00, 0x0C,0x00,
      0x0C,0x00, 0x0C,0x00, 0x00,0x00, 0x00,0x00, 0x00,0x00
    },
    { /* 2 */
      0x00,0x00, 0x00,0x00, 0x3F,0x00, 0x7F,0x80, 0xE1,0xC0,
      0xC0,0xC0, 0xC0,0xC0, 0x00,0xC0, 0x01,0xC0, 0x07,0x80,
      0x0F,0x00, 0x3C,0x00, 0x70,0x00, 0x60,0x00, 0xC0,0x00,
      0xFF,0xC0, 0xFF,0xC0, 0x00,0x00, 0x00,0x00, 0x00,0x00
    },
    { /* 3 */
      0x00,0x00, 0x00,0x00, 0x7C,0x00, 0xFE,0x00, 0xC7,0x00,
      0x83,0x00, 0x83,0x00, 0x07,0x00, 0x1E,0x00, 0x1F,0x00,
      0x03,0x80, 0x01,0x80, 0x81,0x80, 0x81,0x80, 0xC3,0x00,
      0xFF,0x00, 0x7C,0x00, 0x00,0x00, 0x00,0x00, 0x00,0x00
    },
    { /* 4 */
      0x00,0x00, 0x00,0x00, 0x03,0x00, 0x07,0x00, 0x07,0x00,
      0x0F,0x00, 0x1F,0x00, 0x1B,0x00, 0x33,0x00, 0x73,0x00,
      0x63,0x00, 0xC3,0x00, 0xFF,0xC0, 0xFF,0xC0, 0x03,0x00,
      0x03,0x00, 0x03,0x00, 0x00,0x00, 0x00,0x00, 0x00,0x00
    },
    { /* 5 */
      0x00,0x00, 0x00,0x00, 0x7F,0x80, 0x7F,0x80, 0x60,0x00,
      0x60,0x00, 0x60,0x00, 0x7E,0x00, 0xFF,0x80, 0xE1,0xC0,
      0x00,0xC0, 0x00,0xC0, 0x00,0xC0, 0xC0,0xC0, 0xE1,0x80,
      0x7F,0x80, 0x3E,0x00, 0x00,0x00, 0x00,0x00, 0x00,0x00
    },
    { /* 6 */
      0x00,0x00, 0x00,0x00, 0x1F,0x00, 0x3F,0x80, 0x71,0xC0,
      0x60,0xC0, 0xC0,0x00, 0xCF,0x00, 0xFF,0x80, 0xE1,0xC0,
      0xC0,0xC0, 0xC0,0xC0, 0xC0,0xC0, 0xC0,0xC0, 0x61,0x80,
      0x3F,0x80, 0x1E,0x00, 0x00,0x00, 0x00,0x00, 0x00,0x00
    },
    { /* 7 */
      0x00,0x00, 0x00,0x00, 0xFF,0xC0, 0xFF,0xC0, 0x01,0x80,
      0x03,0x80, 0x03,0x00, 0x06,0x00, 0x06,0x00, 0x0C,0x00,
      0x0C,0x00, 0x18,0x00, 0x18,0x00, 0x18,0x00, 0x30,0x00,
      0x30,0x00, 0x30,0x00, 0x00,0x00, 0x00,0x00, 0x00,0x00
    },
    { /* 8 */
      0x00,0x00, 0x00,0x00, 0x3F,0x00, 0x7F,0x80, 0xE1,0xC0,
      0xC0,0xC0, 0xC0,0xC0, 0xE1,0xC0, 0x7F,0x80, 0x7F,0x80,
      0xE1,0xC0, 0xC0,0xC0, 0xC0,0xC0, 0xC0,0xC0, 0xE1,0xC0,
      0x7F,0x80, 0x1F,0x00, 0x00,0x00, 0x00,0x00, 0x00,0x00
    },
    { /* 9 */
      0x00,0x00, 0x00,0x00, 0x3C,0x00, 0x7F,0x00, 0x63,0x00,
      0xC1,0x80, 0xC1,0x80, 0xC1,0x80, 0xC1,0x80, 0xE3,0x80,
      0x7F,0x80, 0x3D,0x80, 0x01,0x80, 0xC3,0x00, 0xE7,0x00,
      0x7E,0x00, 0x3C,0x00, 0x00,0x00, 0x00,0x00, 0x00,0x00
    },
};

void st7306_draw_digit_10x20(int x, int y, char c, int color)
{
    if (c < '0' || c > '9') return;
    const uint8_t *bmp = font_digits_10x20[c - '0'];
    for (int row = 0; row < 20; row++) {
        uint8_t b0 = bmp[row * 2];
        uint8_t b1 = bmp[row * 2 + 1];
        for (int col = 0; col < 10; col++) {
            int src_col = col;
            int byte_idx = src_col / 8;
            int bit_idx = src_col % 8;
            uint8_t byte_val = (byte_idx == 0) ? b0 : b1;
            if (byte_val & (0x80 >> bit_idx)) {
                st7306_set_pixel(x + col, y + row, color);
            }
        }
    }
}

// ── Draw a single ASCII character scaled to arbitrary size ──────────────────
void st7306_draw_char_scaled(int x, int y, char c, int tw, int th, int color)
{
    if ((unsigned char)c > 0x7F) return;
    const uint8_t *glyph = &font8x16[(unsigned char)c * 16];
    for (int oy = 0; oy < th; oy++) {
        int src_row = oy * 16 / th;
        uint8_t line = glyph[src_row];
        for (int ox = 0; ox < tw; ox++) {
            int src_col = ox * 8 / tw;
            if (line & (0x80 >> src_col))
                st7306_set_pixel(x + ox, y + oy, color);
        }
    }
}

// ── Draw a single ASCII character scaled to 7×14 ─────────────────────────────
void st7306_draw_char_7x14(int x, int y, unsigned char c, int color)
{
    if (c > 0x7F) return;
    const uint8_t *glyph = &font8x16[(int)c * 16];
    // Scale 8×16 → 7×14 by nearest-neighbor sampling
    for (int oy = 0; oy < 14; oy++) {
        int src_row = oy * 16 / 14;
        if (src_row >= 16) src_row = 15;
        uint8_t line = glyph[src_row];
        for (int ox = 0; ox < 7; ox++) {
            int src_col = ox * 8 / 7;
            if (src_col >= 8) src_col = 7;
            if (line & (0x80 >> src_col)) {
                st7306_set_pixel(x + ox, y + oy, color);
            }
        }
    }
}

// ── Draw a single 16×16 character from a bitmap ──────────────────────────────
static void draw_char_16x16(int x, int y, const uint8_t *bitmap, int color)
{
    for (int dy = 0; dy < 16; dy++) {
        uint8_t b0 = bitmap[dy * 2];
        uint8_t b1 = bitmap[dy * 2 + 1];
        for (int dx = 0; dx < 8; dx++) {
            if (b0 & (0x80 >> dx))
                st7306_set_pixel(x + dx, y + dy, color);
        }
        for (int dx = 0; dx < 8; dx++) {
            if (b1 & (0x80 >> dx))
                st7306_set_pixel(x + 8 + dx, y + dy, color);
        }
    }
}

// ── UTF-8 text rendering ─────────────────────────────────────────────────────
void st7306_draw_text(int x, int y, const char *text, int color)
{
    int cur_x = x;
    while (*text) {
        unsigned char c = (unsigned char)*text;
        if (c < 0x80) {
            // ASCII: 1 byte → 8px wide
            draw_char_8x16(cur_x, y, c, color);
            cur_x += 8;
            text++;
        } else if ((c & 0xE0) == 0xC0) {
            // 2-byte UTF-8 (skip)
            text += 2;
        } else if ((c & 0xF0) == 0xE0) {
            // 3-byte UTF-8 → check for "的" (E7 9A 84)
            if (text[0] == 0xE7 && text[1] == 0x9A && text[2] == 0x84) {
                draw_char_16x16(cur_x, y, font_de_16x16, color);
                cur_x += 16;
            }
            text += 3;
        } else if ((c & 0xF8) == 0xF0) {
            text += 4;
        } else {
            text++;
        }
    }
}

int st7306_text_width(const char *text)
{
    int width = 0;
    while (*text) {
        unsigned char c = (unsigned char)*text;
        if (c < 0x80) {
            width += 8;
            text++;
        } else if ((c & 0xE0) == 0xC0) {
            text += 2;
        } else if ((c & 0xF0) == 0xE0) {
            width += 16;
            text += 3;
        } else if ((c & 0xF8) == 0xF0) {
            text += 4;
        } else {
            text++;
        }
    }
    return width;
}

// ── Hardware reset ────────────────────────────────────────────────────────────
static void hardware_reset(void)
{
    gpio_config_t rst_cfg = {
        .pin_bit_mask = 1ULL << ST7306_RST_PIN,
        .mode = GPIO_MODE_OUTPUT,
        .pull_up_en = GPIO_PULLUP_DISABLE,
        .pull_down_en = GPIO_PULLDOWN_DISABLE,
        .intr_type = GPIO_INTR_DISABLE,
    };
    gpio_config(&rst_cfg);

    gpio_set_level(ST7306_RST_PIN, 0);
    vTaskDelay(pdMS_TO_TICKS(100));
    gpio_set_level(ST7306_RST_PIN, 1);
    vTaskDelay(pdMS_TO_TICKS(100));
}

// ── Full initialization ──────────────────────────────────────────────────────
esp_err_t st7306_init(void)
{
    // Create frame buffer mutex
    s_fb_mutex = xSemaphoreCreateMutex();

    // 1. SPI bus initialization
    spi_bus_config_t bus_cfg = {
        .sclk_io_num   = ST7306_CLK_PIN,
        .mosi_io_num   = ST7306_MOSI_PIN,
        .miso_io_num   = -1,
        .quadwp_io_num = -1,
        .quadhd_io_num = -1,
        .max_transfer_sz = ST7306_BUF_SIZE + 16,
    };
    ESP_ERROR_CHECK(spi_bus_initialize(SPI3_HOST, &bus_cfg, SPI_DMA_CH_AUTO));

    // 2. Panel IO (handles DC line automatically)
    esp_lcd_panel_io_spi_config_t io_cfg = {
        .cs_gpio_num    = ST7306_CS_PIN,
        .dc_gpio_num    = ST7306_DC_PIN,
        .spi_mode       = 0,
        .pclk_hz        = 10 * 1000 * 1000,  // 10 MHz
        .trans_queue_depth = 10,
        .lcd_cmd_bits   = 8,
        .lcd_param_bits = 8,
        .on_color_trans_done = NULL,
        .user_ctx       = NULL,
    };
    ESP_ERROR_CHECK(esp_lcd_new_panel_io_spi(SPI3_HOST, &io_cfg, &s_io_handle));

    // 3. Hardware reset
    hardware_reset();

    // 4. ST7306 init command sequence (from Waveshare reference)
    send_cmd(0xD6, (uint8_t[]){0x17, 0x02}, 2);  // NVM Load Control
    send_cmd(0xD1, (uint8_t[]){0x01}, 1);          // Booster Enable
    send_cmd(0xC0, (uint8_t[]){0x11, 0x04}, 2);   // Gate Voltage Control
    send_cmd(0xC1, (uint8_t[]){0x69, 0x69, 0x69, 0x69}, 4);  // VSHP
    send_cmd(0xC2, (uint8_t[]){0x19, 0x19, 0x19, 0x19}, 4);  // VSLP
    send_cmd(0xC4, (uint8_t[]){0x4B, 0x4B, 0x4B, 0x4B}, 4);  // VSHN
    send_cmd(0xC5, (uint8_t[]){0x19, 0x19, 0x19, 0x19}, 4);  // VSLN
    send_cmd(0xD8, (uint8_t[]){0x80, 0xE9}, 2);   // OSC Setting
    send_cmd(0xB2, (uint8_t[]){0x02}, 1);          // Frame Rate Control
    send_cmd(0xB3, (uint8_t[]){0xE5, 0xF6, 0x05, 0x46,
             0x77, 0x77, 0x77, 0x77, 0x76, 0x45}, 10);  // Gate EQ HPM
    send_cmd(0xB4, (uint8_t[]){0x05, 0x46,
             0x77, 0x77, 0x77, 0x77, 0x76, 0x45}, 8);  // Gate EQ LPM
    send_cmd(0x62, (uint8_t[]){0x32, 0x03, 0x1F}, 3);   // Gate Timing
    send_cmd(0xB7, (uint8_t[]){0x13}, 1);          // Source EQ Enable
    send_cmd(0xB0, (uint8_t[]){0x64}, 1);          // Gate Line Setting (100 → 400 rows)

    send_cmd_no_params(0x11);                      // Sleep Out
    vTaskDelay(pdMS_TO_TICKS(200));

    send_cmd(0xC9, (uint8_t[]){0x00}, 1);          // Source Voltage Select
    send_cmd(0x36, (uint8_t[]){0x48}, 1);          // MADCTL (MX=1)
    send_cmd(0x3A, (uint8_t[]){0x11}, 1);          // Data Format (3-write)
    send_cmd(0xB9, (uint8_t[]){0x20}, 1);          // Gamma Mode (Mono)
    send_cmd(0xB8, (uint8_t[]){0x29}, 1);          // Panel Setting
    // Display Inversion removed — white background, black text

    send_cmd(0x2A, (uint8_t[]){0x12, 0x2A}, 2);   // Column Address
    send_cmd(0x2B, (uint8_t[]){0x00, 0xC7}, 2);   // Row Address

    send_cmd(0x35, (uint8_t[]){0x00}, 1);          // Tearing Effect On
    send_cmd(0xD0, (uint8_t[]){0xFF}, 1);          // Auto Power Down

    send_cmd_no_params(0x38);                       // High Power Mode ON
    send_cmd_no_params(0x29);                       // Display ON

    // 5. Clear frame buffer
    st7306_clear();

    return ESP_OK;
}

// ── Graphics primitives ────────────────────────────────────────────────────────

void st7306_draw_hline(int x1, int x2, int y, int color)
{
    if (y < 0 || y >= ST7306_HEIGHT) return;
    if (x1 > x2) { int t = x1; x1 = x2; x2 = t; }
    if (x1 < 0) x1 = 0;
    if (x2 >= ST7306_WIDTH) x2 = ST7306_WIDTH - 1;
    for (int x = x1; x <= x2; x++)
        st7306_set_pixel(x, y, color);
}

void st7306_draw_vline(int x, int y1, int y2, int color)
{
    if (x < 0 || x >= ST7306_WIDTH) return;
    if (y1 > y2) { int t = y1; y1 = y2; y2 = t; }
    if (y1 < 0) y1 = 0;
    if (y2 >= ST7306_HEIGHT) y2 = ST7306_HEIGHT - 1;
    for (int y = y1; y <= y2; y++)
        st7306_set_pixel(x, y, color);
}

void st7306_draw_rect(int x, int y, int w, int h, int color)
{
    st7306_draw_hline(x, x + w - 1, y, color);
    st7306_draw_hline(x, x + w - 1, y + h - 1, color);
    st7306_draw_vline(x, y, y + h - 1, color);
    st7306_draw_vline(x + w - 1, y, y + h - 1, color);
}

void st7306_draw_filled_rect(int x, int y, int w, int h, int color)
{
    if (w <= 0 || h <= 0) return;
    for (int dy = 0; dy < h; dy++)
        st7306_draw_hline(x, x + w - 1, y + dy, color);
}
